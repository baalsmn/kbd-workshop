// hachigo74, generated by tools/lib/qmk_gen.py
#include QMK_KEYBOARD_H
#include "keymap_hungarian.h"

// ---- keys per minute: key presses in ten 1 s slots, the sum of the last 10 s x 6 ----
#define KPM_SLOTS 10
static uint16_t kpm_slot[KPM_SLOTS];
static uint8_t  kpm_now;
static uint32_t kpm_slot_start;

static void kpm_advance(void) {
    while (timer_elapsed32(kpm_slot_start) >= 1000) {
        kpm_slot_start += 1000;
        kpm_now = (kpm_now + 1) % KPM_SLOTS;
        kpm_slot[kpm_now] = 0;
    }
}

uint16_t kpm_get(void) {
    kpm_advance();
    uint16_t sum = 0;
    for (uint8_t i = 0; i < KPM_SLOTS; i++) sum += kpm_slot[i];
    return sum * (60 / KPM_SLOTS);
}

void keyboard_post_init_kb(void) {
    kpm_slot_start = timer_read32();
    keyboard_post_init_user();
}

static bool fn_active(void) {
    return layer_state_is(1) || (get_oneshot_layer() == 1 && get_oneshot_layer_state());
}

// ---- keys whose AltGr character is not the one Windows puts on that key position ----
static uint16_t held_code[3];

static bool altgr_key(uint8_t i, uint16_t plain, uint16_t with_altgr, keyrecord_t *record) {
    if (record->event.pressed) {
        held_code[i] = (get_mods() & MOD_BIT(KC_RALT)) ? with_altgr : plain;
        register_code16(held_code[i]);
    } else {
        unregister_code16(held_code[i]);
    }
    return false;
}

bool process_record_kb(uint16_t keycode, keyrecord_t *record) {
    if (record->event.pressed) {
        kpm_advance();
        if (kpm_slot[kpm_now] < UINT16_MAX) kpm_slot[kpm_now]++;
    }
    if (!process_record_user(keycode, record)) return false;
    switch (keycode) {
        case HU_PAREN_L: return altgr_key(0, HU_LPRN, HU_B, record);    // AltGr + B = {
        case HU_PAREN_R: return altgr_key(1, HU_RPRN, HU_N, record);    // AltGr + N = }
        case HU_AT_ASTR: return altgr_key(2, HU_AT, HU_MINS, record);   // AltGr + - = *
        case SFT_FN:
            if (record->tap.count) {                                    // tapped: one-shot Fn
                if (record->event.pressed) {
                    set_oneshot_layer(1, ONESHOT_START);
                } else {
                    clear_oneshot_layer_state(ONESHOT_PRESSED);
                }
                return false;
            }
            return true;                                                // held: Shift
        case SPC_ENT:
            if (!record->tap.count) {                                   // held: Enter
                if (record->event.pressed) {
                    register_code(KC_ENT);
                } else {
                    unregister_code(KC_ENT);
                }
                return false;
            }
            return true;                                                // tapped: Space
    }
    return true;
}

#ifdef OLED_ENABLE
// the module is mounted turned round (header towards the user)
oled_rotation_t oled_init_kb(oled_rotation_t rotation) {
    return OLED_ROTATION_180;
}

// ---- status screen in a 9 x 12 font (tools/lib/oled_font.py), drawn pixel by pixel ----
#define FONT_W 9
#define FONT_H 14
#define ROW_Y(n) ((n) * 17)
static const char font_chars[] = " ABCEFGHILNOPRSVWY0123456789%-";
static const uint8_t font_rows[][FONT_H] = {
    {0x00, 0x00, 0x00, 0x00, 0x00, 0x00, 0x00, 0x00, 0x00, 0x00, 0x00, 0x00, 0x00, 0x00},  // ' '
    {0x3C, 0x7E, 0xC3, 0xC3, 0xC3, 0xC3, 0xFF, 0xFF, 0xC3, 0xC3, 0xC3, 0xC3, 0x00, 0x00},  // 'A'
    {0xFC, 0xFE, 0xC3, 0xC3, 0xC6, 0xFC, 0xFC, 0xC6, 0xC3, 0xC3, 0xFE, 0xFC, 0x00, 0x00},  // 'B'
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    {0x00, 0x00, 0x00, 0x00, 0x00, 0xFF, 0xFF, 0x00, 0x00, 0x00, 0x00, 0x00, 0x00, 0x00},  // '-'
};

static void draw_char(uint8_t x, uint8_t y, char c) {
    uint8_t g = 0;                                                      // unknown character: blank
    for (uint8_t i = 0; font_chars[i]; i++) {
        if (font_chars[i] == c) {
            g = i;
            break;
        }
    }
    for (uint8_t r = 0; r < FONT_H; r++) {
        for (uint8_t col = 0; col < FONT_W; col++) {
            oled_write_pixel(x + col, y + r, col < 8 && (font_rows[g][r] & (0x80 >> col)));
        }
    }
}

// text from x, padded with blanks to `width` characters so a shorter value clears the longer one
static void draw_text(uint8_t x, uint8_t y, const char *s, uint8_t width) {
    for (uint8_t i = 0; i < width; i++) {
        draw_char(x + i * FONT_W, y, *s ? *s : ' ');
        if (*s) s++;
    }
}

// right-aligned text ending at the screen's right edge, cleared to `width` characters
static void draw_right(uint8_t y, const char *s, uint8_t width) {
    uint8_t n = 0;
    while (s[n]) n++;
    uint8_t x = 128 - width * FONT_W;
    draw_text(x, y, "", width - n);
    draw_text(x + (width - n) * FONT_W, y, s, n);
}

// a number as text, optionally with a percent sign; returns its first character in buf (8 bytes)
static const char *num_text(char *buf, uint16_t v, bool percent) {
    uint8_t i = 7;
    buf[i] = 0;
    if (percent) buf[--i] = '%';
    do {
        buf[--i] = '0' + v % 10;
        v /= 10;
    } while (v);
    return buf + i;
}

static const char *layer_name(void) {
    switch (get_highest_layer(layer_state | default_layer_state)) {
        case 0: return "BASE";
        case 1: return "HIGH";
        case 2: return "LOW";
        default: return "L3";
    }
}

#ifdef RGB_MATRIX_ENABLE
static const char *rgb_name(void) {
    if (!rgb_matrix_is_enabled()) return "OFF";
    switch (rgb_matrix_get_mode()) {
        case RGB_MATRIX_SOLID_COLOR: return "SOL";
        case RGB_MATRIX_BREATHING: return "BRE";
        case RGB_MATRIX_CYCLE_ALL: return "CYC";
        case RGB_MATRIX_CYCLE_LEFT_RIGHT: return "CLR";
        case RGB_MATRIX_RAINBOW_MOVING_CHEVRON: return "CHV";
        case RGB_MATRIX_SOLID_REACTIVE_SIMPLE: return "REA";
        default: return "---";
    }
}

// the effects that have a speed: not solid colour, off or an unknown one
static bool rgb_uses_speed(void) {
    if (!rgb_matrix_is_enabled()) return false;
    switch (rgb_matrix_get_mode()) {
        case RGB_MATRIX_BREATHING:
        case RGB_MATRIX_CYCLE_ALL:
        case RGB_MATRIX_CYCLE_LEFT_RIGHT:
        case RGB_MATRIX_RAINBOW_MOVING_CHEVRON:
        case RGB_MATRIX_SOLID_REACTIVE_SIMPLE:
            return true;
        default:
            return false;
    }
}
#endif

bool oled_task_kb(void) {
    if (!oled_task_user()) return false;
    static uint32_t last_draw;
    if (timer_elapsed32(last_draw) < 50) return false;
    last_draw = timer_read32();
    char buf[8];

    // left column: layer, FN, CAPS
    draw_text(0, ROW_Y(0), layer_name(), 4);
    draw_text(0, ROW_Y(1), fn_active() ? "FN" : "", 4);
    draw_text(0, ROW_Y(2), host_keyboard_led_state().caps_lock ? "CAPS" : "", 4);

    // right column: RGB effect, brightness (% of the firmware's cap), effect speed, KPM
#ifdef RGB_MATRIX_ENABLE
    draw_right(ROW_Y(0), rgb_name(), 4);
    draw_right(ROW_Y(1), num_text(buf, (rgb_matrix_get_val() * 100U + RGB_MATRIX_MAXIMUM_BRIGHTNESS / 2) / RGB_MATRIX_MAXIMUM_BRIGHTNESS, true), 4);
    draw_right(ROW_Y(2), rgb_uses_speed() ? num_text(buf, (rgb_matrix_get_speed() * 100U + 127) / 255, true) : "", 4);
#endif
    draw_right(ROW_Y(3), num_text(buf, kpm_get(), false), 5);
    return false;
}
#endif

#ifdef RGB_MATRIX_ENABLE
static const uint8_t indicator_leds[] = INDICATOR_LEDS;

bool rgb_matrix_indicators_advanced_kb(uint8_t led_min, uint8_t led_max) {
    if (!rgb_matrix_indicators_advanced_user(led_min, led_max)) return false;
    bool fn = fn_active();
    for (uint8_t i = 0; i < sizeof(indicator_leds); i++) {
        if (fn) {
            RGB_MATRIX_INDICATOR_SET_COLOR(indicator_leds[i], INDICATOR_FN_R, INDICATOR_FN_G, INDICATOR_FN_B);
        } else {
            RGB_MATRIX_INDICATOR_SET_COLOR(indicator_leds[i], 0, 0, 0);
        }
    }
    return true;
}
#endif
